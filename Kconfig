## Kconfig
```kconfig
# SPDX-License-Identifier: GPL-2.0-only
config VIDEO_SUN6I_MIPI_CSI
	tristate "Allwinner V3s Camera Sensor Interface driver with MIPI-CSI2 support"
	depends on VIDEO_V4L2 && COMMON_CLK && VIDEO_V4L2_SUBDEV_API && HAS_DMA
	depends on ARCH_SUNXI || COMPILE_TEST
	select VIDEOBUF2_DMA_CONTIG
	select REGMAP_MMIO
	select V4L2_FWNODE
	help
	   Support for the Allwinner Camera Sensor Interface witi MIPI-CSI2 Controller on V3s.
```
